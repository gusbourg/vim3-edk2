/dts-v1/;
/plugin/;

/*
 * Runtime device-tree policy for the VIM3 eMMC/SPIFC pin split.
 *
 * EMMC_D4..D7 share pins with the on-board SPI NOR.  Firmware owns SPIFC
 * exclusively for runtime variables, while Linux sees eMMC in four-bit mode
 * and a disabled SPIFC controller.
 *
 * Copyright (c) 2026, Gus Bourg. All rights reserved.<BR>
 * SPDX-License-Identifier: BSD-2-Clause-Patent
 */

&sd_emmc_c {
	pinctrl-0 = <&emmc_ctrl_pins>, <&emmc_data_4b_pins>,
		    <&emmc_ds_pins>;
	bus-width = <4>;
};

&spifc {
	status = "disabled";
};
