/dts-v1/;
/plugin/;

/*
 * Linux-only SPI maintenance policy.  Do not publish this tree to an OS while
 * EDK2 runtime variables are active: firmware owns SPIFC in normal operation.
 *
 * Copyright (c) 2026, Gus Bourg. All rights reserved.<BR>
 * SPDX-License-Identifier: BSD-2-Clause-Patent
 */

&sd_emmc_c {
	pinctrl-0 = <&emmc_ctrl_pins>, <&emmc_data_4b_pins>,
		    <&emmc_ds_pins>;
	bus-width = <4>;
};

&spifc {
	status = "okay";
};
